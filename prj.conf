## CMakeLists.txt
```
cmake_minimum_required(VERSION 3.20.0)
find_package(Zephyr REQUIRED HINTS $ENV{ZEPHYR_BASE})

list(APPEND ZEPHYR_EXTRA_MODULES
    ${CMAKE_CURRENT_SOURCE_DIR}/drivers
)
add_subdirectory(drivers)

project(test)

target_sources(app PRIVATE src/main.c)
```

## Kconfig
```
config ENCODER0_TIMER
	int "HW timer used by 1st encoder"
	default 1
	help
	  Timer used by encoder1.

config ENCODER1_TIMER
	int "HW timer used by 2nd encoder"
	default 2
	help
	  Timer used by encoder2.

source "Kconfig.zephyr"
```

## prj.conf
```kconfig
# building encoder driver on top of zephyr/drivers/sensor
CONFIG_SENSOR=y

# using these nrfx instances
CONFIG_NRFX_TIMER1=y
CONFIG_NRFX_TIMER2=y
CONFIG_NRFX_GPIOTE=y

# NB - TIMER0 is often occupied by BLE
# Selecting HW timers for the encoders
CONFIG_ENCODER0_TIMER=1
CONFIG_ENCODER1_TIMER=2

# testing github actions
# Should trigger github action error

CONFIG_LOG=y
```

## nrf52840dk_nrf52840.overlay
```dts
/*
 * Copyright (c) 2020 Intel Corporation
 *
 * SPDX-License-Identifier: Apache-2.0
 */

 / {

	encoder_left: encoder_left {
		compatible = "encoder_counter";
		status = "okay";
		gpios = <&gpio0 26 GPIO_ACTIVE_LOW>;
	};

	encoder_right: encoder_right {
		compatible = "encoder_counter";
		status = "okay";
		gpios = <&gpio0 27 GPIO_ACTIVE_LOW>;
	};
};

&i2c0 {
	status = "disabled";
};
```

## dts/bindings/encoder.yaml
```yaml
description: ENCODER counter parent node

compatible: "encoder_counter"

include: base.yaml

properties:
    gpios:
      type: phandle-array
      required: true
      description: GPIO pin

    label:
      type: string
      description: Descriptive name of the key
    
```

## src/main.c
```c
#include <zephyr/device.h>
#include <zephyr/drivers/sensor.h>
#include <zephyr/kernel.h>
#include <zephyr/logging/log.h>

LOG_MODULE_REGISTER(Example_App, LOG_LEVEL_INF);

static struct sensor_value encoder_left_data;
static struct sensor_value encoder_right_data;

static const struct device* encoder_left_dev = DEVICE_DT_GET(DT_NODELABEL(encoder_left));
static const struct device* encoder_right_dev = DEVICE_DT_GET(DT_NODELABEL(encoder_right));

void get_encoder_data()
{
    int ret;
    ret = sensor_channel_get(encoder_left_dev, SENSOR_CHAN_POS_DY, &encoder_left_data);
    if (ret != 0) {
        LOG_INF("sensor_channel_get error: %d", ret);
    }

    ret = sensor_channel_get(encoder_right_dev, SENSOR_CHAN_POS_DY, &encoder_right_data);
    if (ret != 0) {
        LOG_INF("sensor_channel_get error: %d", ret);
    }
}
int main(void)
{
    if (encoder_left_dev == NULL || encoder_left_dev == NULL) {
        LOG_INF("ERROR: encoder not found");
        return -1;
    }
    if (!device_is_ready(encoder_left_dev)) {
        LOG_INF("left encoder not ready");
    } else {
        LOG_INF("left encoder ready");
    }
    if (!device_is_ready(encoder_right_dev)) {
        LOG_INF("right encoder not ready");
    } else {
        LOG_INF("right encoder ready");
    }

    while (1) {
        int ret;
        ret = sensor_channel_get(encoder_left_dev, SENSOR_CHAN_ALL, &encoder_left_data);
        ret = sensor_channel_get(encoder_right_dev, SENSOR_CHAN_ALL, &encoder_right_data);
        LOG_INF("encoder left data %d", encoder_left_data.val1);
        LOG_INF("encoder right data %d", encoder_right_data.val1);
        k_msleep(1000); // Update heading at least every time we get gyro measurments which is 12.5 Hz.
    }

// Lets test github actions again
// adding stuff to break compilation

    return 0;
}
```
